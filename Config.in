## Config.in
~~~~kconfig
menu "Piccolo-2go ARM64 RK3326 Handheld Appliance"

config BR2_PACKAGE_PICCOLO_2GO_BASE
	bool "Piccolo-2go RK3326 Runtime & Hardware Scripts (BATLEXP G350 / R36S)"
	default y
	select BR2_PACKAGE_AX_SDK
	select BR2_PACKAGE_FLAC_AX
	select BR2_PACKAGE_RETROARCH
	select BR2_PACKAGE_LIBRETRO_FBNEO
	select BR2_PACKAGE_DTC
	help
	  Deterministic ARM64 (4x Cortex-A35) handheld appliance layer for the
	  BATLEXP G350 and R36S with 1:2:1 core isolation, 1024 MB LZ4 ZRAM,
	  KMS/DRM + Mali-G31 Panfrost GLES 3.0 direct scanout, dual SanDisk
	  Extreme PRO (64 GB TF1 + 128 GB TF2) storage, early HiBy FC3 1.3 Vrms
	  USB-C OTG DAC gain staging, and initial FBNeo + FLAC_AX bring-up.

source "$BR2_EXTERNAL_PICCOLO_2GO_PATH/package/ax-sdk/Config.in"
source "$BR2_EXTERNAL_PICCOLO_2GO_PATH/package/flac-ax/Config.in"
source "$BR2_EXTERNAL_PICCOLO_2GO_PATH/package/piccolo-2go-tools/Config.in"

endmenu
```[cite: 14]

And for quick reference, here again is the full `package/flac-ax/Config.in` file so both are side by side:

```kconfig
config BR2_PACKAGE_FLAC_AX
	bool "FLAC_AX (Bit-Perfect S32_LE / DoP & Tracker Audio Engine)"
	default y
	select BR2_PACKAGE_AX_SDK
	select BR2_PACKAGE_ALSA_LIB
	select BR2_PACKAGE_FLAC
	select BR2_PACKAGE_LIBOPENMPT
	help
	  Bit-perfect S32_LE / DoP audiophile transport and libopenmpt
	  tracker jukebox tuned for early HiBy FC3 (1.3 Vrms) USB-C DACs.
~~~~

## package/ax-sdk/Config.in
```kconfig
config BR2_PACKAGE_AX_SDK
	bool "ax-sdk (Deterministic Hardware Runtime)"
	default y
	help
	  Shared dependency-free C++20 deterministic hardware runtime
	  (core affinity, SCHED_FIFO audio clock, memory locking).
```

## package/flac-ax/Config.in
```kconfig
config BR2_PACKAGE_FLAC_AX
	bool "FLAC_AX (Bit-Perfect S32_LE / DoP & Tracker Audio Engine)"
	default y
	select BR2_PACKAGE_AX_SDK
	select BR2_PACKAGE_ALSA_LIB
	select BR2_PACKAGE_FLAC
	select BR2_PACKAGE_LIBOPENMPT
	help
	  Bit-perfect S32_LE / DoP audiophile transport and libopenmpt
	  tracker jukebox tuned for early HiBy FC3 (1.3 Vrms) USB-C DACs.

config BR2_PACKAGE_FLAC_AX_APPLIANCE_TUI
	bool "ax_appliance_tui (Espresso Appliance Boot Launcher)"
	default y
	depends on BR2_PACKAGE_FLAC_AX
	help
	  Zero-bloat C++20 Espresso/Copper terminal launcher pinned to
	  housekeeping Core 3 on RK3326 handhelds.
```

## package/piccolo-2go-tools/Config.in
```kconfig
config BR2_PACKAGE_PICCOLO_2GO_TOOLS
	bool "piccolo-2go-tools (dtb-select & ax-powerd)"
	default y
	help
	  Lightweight zero-dependency C utilities for Rockchip RK3326
	  handhelds (BATLEXP G350 & all R36S variants): runtime MIPI DSI
	  panel DTB selector (dtb-select) and Core 3 safe KEY_POWER /
	  75C thermal rollback / 3280 mV LiPo brownout daemon (ax-powerd).
```
